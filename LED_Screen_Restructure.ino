// Setup
    #include <FastLED.h>
    #define NUM_LEDS 512
    #define DATA_PIN A0
    CRGB leds[NUM_LEDS];
    // SCREENS 
        const int default1[] = {15,14,13,12,11,10,9,8,7,6,5,4,3,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510,511};
        const int default2[] = {42,41,40,39,38,37,52,53,54,55,56,57,58,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475,476};
        const int j1y[] = {17,18,19,20,21,22,23,24,25,26,46,45,44,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505,506};
        const int j2y[] = {8,18,19,23,27,28,45,44,43,37,36,35,51,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507,508};
        const int j2p[] = {105,103,118,120,170,182,183,184,166,361,359,374,376,426,438,439,440,422};
        const int f1p[] = {15,14,13,12,11,10,9,8,7,6,5,4,3,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510,511};
        const int f2p[] = {1,2,3,4,5,6,7,9,10,11,12,13,14,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510,511};
        const int f3p[] = {54,55,56,68,70,71,72,73,74,76,82,84,85,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472,473};
        const int f3r[] = {214,216};
        const int s1b[] = {21,22,23,24,25,26,30,31,43,42,41,40,39,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485,484};
        const int s2b[] = {21,42,52,53,54,63,75,74,73,64,83,84,85,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484,483};
        const int s3b[] = {13,12,11,10,9,17,18,19,20,21,22,23,30,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505,507};
        const int d1g[] = {47,46,45,44,41,38,37,36,34,33,32,48,52,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474,478};
        const int d2g[] = {35,34,59,60,61,62,75,74,69,68,67,66,65,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499,500};
        const int d3g[] = {17,18,19,20,21,46,45,44,43,42,49,53,78,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492,484};
        const int a1r[] = {16,17,18,19,20,21,22,41,42,43,44,45,46,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510,511};
        const int a2r[] = {17,18,19,20,23,24,28,30,31,33,35,39,40,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494,495};
        const int a3r[] = {52,74,75,83,84,85,105,106,108,109,114,115,118,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502,503};
        const int a3o[] = {107,116,117,140,139,138,147,149,150,172,169,182,201,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484,507};
        const int a3y[] = {148,171,170,181,180,204,203,202,211,212,213,236,235,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505,506};
    // INPUT PINS
        int pinLW = 22; // Leg White
        int pinLY = 23; // Leg Yellow
        int pinLR = 24; // Leg Red
        int pinLB = 25; // Leg Blue
        int pinLG = 26; // Leg Green
        int pinPW = 27; // Pentagon White
        int pinPY = 28; // Pentagontagon Yellow
        int pinPR = 29; // Pentagon Red
        int pinPB = 30; // Pentagon Blue
        int pinPG = 31; // Pentagon Green
        int pinBW = 32; // Brain White
        int pinBY = 33; // Brain Yellow
        int pinBR = 34; // Brain Red
        int pinBB = 35; // Brain Blue
        int pinBG = 36; // Brain Green
        int pinHW = 37; // Heart White
        int pinHY = 38; // Heart Yellow
        int pinHR = 39; // Heart Red
        int pinHB = 40; // Heart Blue
        int pinHG = 41; // Heart Green
        int pinSW = 42; // Stomach White
        int pinSY = 43; // Stomach Yellow
        int pinSR = 44; // Stomach Red
        int pinSB = 45; // Stomach Blue
        int pinSG = 46; // Stomach Green
    // TRIGGERS 
        int conditionCode = 0; // Zero is Default
    // VARIABLES
        long randomNumber;

void setup() {
    // Setup LEDS 
    Serial.begin(9600);
    Serial.print("1 of 2 Setting up FastLED... ");
    FastLED.addLeds<WS2811, DATA_PIN, GRB>(leds, NUM_LEDS);
    FastLED.setBrightness(10);
    FastLED.clear(true);
    Serial.println("done.");

    // Setup Inputs 
    Serial.print("2 of 2 Setting up Pins as INPUTS... ");
    pinMode(pinLW, INPUT);
    pinMode(pinLY, INPUT);
    pinMode(pinLR, INPUT);  
    pinMode(pinLB, INPUT);
    pinMode(pinLG, INPUT);
    pinMode(pinPW, INPUT);
    pinMode(pinPY, INPUT);
    pinMode(pinPR, INPUT);
    pinMode(pinPB, INPUT);
    pinMode(pinPG, INPUT);
    pinMode(pinBW, INPUT);
    pinMode(pinBY, INPUT);
    pinMode(pinBR, INPUT);
    pinMode(pinBB, INPUT);
    pinMode(pinBG, INPUT);
    pinMode(pinHW, INPUT);
    pinMode(pinHY, INPUT);
    pinMode(pinHR, INPUT);
    pinMode(pinHB, INPUT);
    pinMode(pinHG, INPUT);
    pinMode(pinSW, INPUT);
    pinMode(pinSY, INPUT);
    pinMode(pinSR, INPUT);
    pinMode(pinSB, INPUT);
    pinMode(pinSG, INPUT);
    Serial.println("done.");
}

void display() {
    Serial.print("Starting display... ");
    FastLED.show();
    delay(5000);
    FastLED.clear(true);
    Serial.println("done.");
}

void addDisplay(int vScreenArray[], CRGB vColor) {
    // See https://forum.arduino.cc/t/crgb-color-as-a-function-argument/620376 for sample calls
    Serial.print("Starting addDisplay...     ");
    int i =0;
    int arraySize = sizeof(vScreenArray)/sizeof(int);
    Serial.print("Size = ");
    Serial.print(arraySize);
    for(i = 0; i < arraySize; i++){
        leds[vScreenArray[i]] = CRGB::vColor; //vColor;
    }
    Serial.println("done.");
}

void clearLEDs() {
    Serial.print("Starting addDisplay...     ");
    int i =0;
    for(i=0; i < NUM_LEDS + 1; i++){
        leds[i] = CRGB::Black;
    }
    Serial.println("done.");
}

void loop() {
    FastLED.clear(true);

    // Read Signals
        int sigLW = digitalRead(pinLW, INPUT);
        int sigLY = digitalRead(pinLY, INPUT);
        int sigLR = digitalRead(pinLR, INPUT);
        int sigLB = digitalRead(pinLB, INPUT);
        int sigLG = digitalRead(pinLG, INPUT);
        int sigPW = digitalRead(pinPW, INPUT);
        int sigPY = digitalRead(pinPY, INPUT);
        int sigPR = digitalRead(pinPR, INPUT);
        int sigPB = digitalRead(pinPB, INPUT);
        int sigPG = digitalRead(pinPG, INPUT);
        int sigBW = digitalRead(pinBW, INPUT);
        int sigBY = digitalRead(pinBY, INPUT);
        int sigBR = digitalRead(pinBR, INPUT);
        int sigBB = digitalRead(pinBB, INPUT);
        int sigBG = digitalRead(pinBG, INPUT);
        int sigHW = digitalRead(pinHW, INPUT);
        int sigHY = digitalRead(pinHY, INPUT);
        int sigHR = digitalRead(pinHR, INPUT);
        int sigHB = digitalRead(pinHB, INPUT);
        int sigHG = digitalRead(pinHG, INPUT);
        int sigSW = digitalRead(pinSW, INPUT);
        int sigSY = digitalRead(pinSY, INPUT);
        int sigSR = digitalRead(pinSR, INPUT);
        int sigSB = digitalRead(pinSB, INPUT);
        int sigSG = digitalRead(pinSG, INPUT);
    // Calculate Triggers
        if(sigLW == HIGH && sigPW == HIGH && sigBW == HIGH && sigHW == HIGH && sigSW == HIGH) {
            conditionCode = 1; // Fear
        }
        if(sigLY == HIGH && sigPY == HIGH && sigBY == HIGH && sigHY == HIGH && sigSY == HIGH) {
            conditionCode = 2; // Joy
        }
        if(sigLB == HIGH && sigPB == HIGH && sigBB == HIGH && sigHB == HIGH && sigSB == HIGH) {
            conditionCode = 3; // Sad
        }
        if(sigLR == HIGH && sigPR == HIGH && sigBR == HIGH && sigHR == HIGH && sigSR == HIGH) {
            conditionCode = 4; // Anger
        }
        if(sigLR == HIGH && sigPR == HIGH && sigBR == HIGH && sigHR == HIGH && sigSR == HIGH) {
            conditionCode = 5; // Disgust
        }

    // 
    switch (conditionCode) {
        case 1:
            // FEAR - Words in Purple
                int screenArray = f2p;
                CRGB color = "Purple";
                Serial.print("f2p     ");
                addDisplay(screenArray, CRGB::color);
                display();
            // FEAR - Spider and Ghost
                screenArray = f3p;
                CRGB color = "Purple";
                addDisplay(screenArray, CRGB::color);
                screenArray = f3r;
                CRGB color = "Red";
                addDisplay(screenArray, CRGB::color);
                display();
            break;
        case 2:
            /// Joy 1 - BOLD JOY Yellow Words
                int screenArray = j1y;
                CRGB color = "Yellow";
                addDisplay(screenArray, CRGB::color);
                display();
            /// Joy 2 - Sunshine
                int screenArray = j2y;
                CRGB color = "Yellow";
                addDisplay(screenArray, CRGB::color);
                int screenArray = j2p;
                CRGB color = "Purple";
                addDisplay(screenArray, CRGB::color);
                display();
            break;
        case 3:
            /// Sad 1 - Sad Word
                int screenArray = s1b;
                CRGB color = "LightSkyBlue";
                addDisplay(screenArray, CRGB::color);
                display();
            /// Sad 2 - Tear Drops
                int screenArray = s2b;
                CRGB color = "LightSkyBlue";
                addDisplay(screenArray, CRGB::color);
                display();
            /// Sad 3 - Rain Clouds
                int screenArray = s3b;
                CRGB color = "LightSkyBlue";
                addDisplay(screenArray, CRGB::color);
                display();
            break;
        case 4:
            /// Disgust 1 - Disgust Word
                int screenArray = d1g;
                CRGB color = "Green";
                addDisplay(screenArray, CRGB::color);
                display();
            /// Disgust 1 - Brocoli
                int screenArray = d2g;
                CRGB color = "Green";
                addDisplay(screenArray, CRGB::color);
                display();
            break;
        case 5: 
            /// Angry 1 - Rage Red Words
            //    int screenArray = a1r;
            //    CRGB color = "Red";
            //    addDisplay(screenArray, CRGB::color);
            //    display();
            /// Angry 2 - Angry Red Words
                int screenArray = a2r;
                CRGB color = "Red";
                addDisplay(screenArray, CRGB::color);
                display();
            /// Angry 3 - Fire Emojis
                int screenArray = a3r;
                CRGB color = "Red";
                addDisplay(screenArray, CRGB::color);
                int screenArray = a3o;
                CRGB color = "Orange";
                addDisplay(screenArray, CRGB::color);
                int screenArray = a3y;
                CRGB color = "Yellow";
                addDisplay(screenArray, CRGB::color);
                display();
            break;
        default:
            // Default OK Words
                int screenArray = default2;
                randomNumber = random(0,4);
                switch (randomNumber) {
                    case 0: 
                        color = "Green";
                        break;
                    case 1:
                        color = "Yellow";
                        break;
                    case 2: 
                        color = "Purple"
                        break;
                    case 3:
                        color = "LightSkyBlue";
                        break;
                    case 4:
                        color = "Red";
                        break;
                }
                addDisplay(screenArray, CRGB::color);
                display();
            break;
    }
    clearLEDs();
    conditionCode = 0;     
}
